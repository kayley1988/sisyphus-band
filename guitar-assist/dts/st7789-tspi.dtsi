/*
 * st7789-tspi.dtsi - 泰山派 RK3566 + ST7789 1.54寸 240x240 SPI 屏 设备树配置
 *
 * ============================================================
 *  使用前必读
 * ============================================================
 *
 * 1. 【务必先备份原设备树】
 *    cd kernel/arch/arm64/boot/dts/rockchip/
 *    cp tspi-rk3566-user-v10-linux.dts tspi-rk3566-user-v10-linux.dts.bak
 *    改错设备树会导致系统起不来, 只能重新烧录固件。
 *
 * 2. 【必须自己填的 3 个 GPIO】
 *    本文件里所有标着 !!!FILL!!! 的地方必须按你的接线填。
 *    填错不会烧板子, 但屏幕不会亮。
 *
 * 3. 【SPI 引脚复用只有两套, 选错全黑】
 *    M0 组 和 M1 组 是芯片内部的两套引脚映射, 物理上是不同引脚。
 *    你必须确认屏幕的 SCL/SDA 接的是哪一组。
 *
 * ============================================================
 */

/* ============================================================
 * 一、SPI3 控制器节点
 *
 * 在 rk3568.dtsi 里 spi3 已经定义好了寄存器/时钟/中断,
 * 但 status = "disabled"。我们只需要在板级 dts 里启用它。
 *
 * 两个 pinctrl 组解释:
 *   pinctrl-0: 普通速率引脚配置
 *   pinctrl-1: 高速引脚配置(RK 特有的 high_speed 模式, 驱动在
 *              SPI 时钟 > 一定频率时自动切换, 能减少信号振铃)
 * ============================================================ */

&spi3 {
    status = "okay";

    /* 最大时钟。ST7789 数据手册标称 80MHz, 但实际受布线质量限制:
     *   - 杜邦线飞线: 建议 <= 24MHz(线长了会花屏/丢数据)
     *   - 短排线/PCB: 可以到 40~50MHz
     * 调试期先用低值, 确认能亮之后再往上加。
     *
     * 与用户态驱动的对应关系: 这个值只是上限, 实际速率由
     * SPI_IOC_WR_MAX_SPEED_HZ 设置(见 st7789.c) */
    max-freq = <50000000>;

    /* DMA 一定要开。实测数据(来自社区):
     *   不开 DMA: 10MHz 下 240x240 全屏刷新约 55ms
     *   开 DMA:   80MHz 下约 12ms
     * 对 LVGL 界面来说, 这直接决定能不能跑到 30fps。 */
    dma-names = "tx", "rx";

    pinctrl-names = "default", "high_speed";
    /* !!! 关键选择: 确认你的接线是 M0 还是 M1 !!!
     *
     * M0 组(泰山派 40pin 排针上常见):
     *   SCLK = SPI3_CLK_M0  = GPIO4_B3
     *   MOSI = SPI3_MOSI_M0 = GPIO4_B2
     *   CS   = SPI3_CS0_M0  = GPIO4_A6
     *
     * M1 组:
     *   SCLK = SPI3_CLK_M1  = GPIO3_B5
     *   MOSI = SPI3_MOSI_M1 = GPIO3_B6
     *   CS   = SPI3_CS0_M1  = GPIO3_B7
     *
     * 判断方法: 用万用表/查原理图, 看屏幕的 SCL/SDA 接到了哪个引脚。
     * 或者两个都试一遍(改一行, 重编译设备树, 重启, 看哪个能亮)。 */
    pinctrl-0 = <&spi3m0_pins &spi3m0_cs0>;
    pinctrl-1 = <&spi3m0_pins_hs &spi3m0_cs0>;

    /* spi-max-frequency 也可以在控制器级设, 子节点会继承 */
    num-cs = <1>;

    /* ========================================================
     * 二、ST7789 屏幕子节点
     * ======================================================== */
    panel: st7789@0 {
        /* reg = 0 表示用 CS0。如果你接的是 CS1 就改成 1 */
        reg = <0>;

        /* !! compatible 的选择决定走哪个驱动, 见下方"驱动方案二选一" !! */
        compatible = "sitronix,st7789v";

        status = "okay";

        /* SPI 时钟。调试期建议 24MHz, 稳定后往上涨 */
        spi-max-frequency = <40000000>;

        /* SPI 模式。ST7789 支持 mode 0 和 mode 3。
         *   mode 0: 不写这两个属性(默认)
         *   mode 3: 加上 spi-cpol 和 spi-cpha
         * 花屏/全白/乱码时, 第一件事就是试另一个模式。 */
        /* spi-cpol; */
        /* spi-cpha; */

        /* ---- 分辨率 ---- */
        width  = <240>;
        height = <240>;

        /* ---- 下面三个 GPIO 必须自己填 ---- */

        /* DC: 数据/命令选择。接屏幕的 DC 引脚。
         * 格式: <&gpio组 组内序号 GPIO_ACTIVE_HIGH>
         *   gpio 组的计算: GPIO4_B3 -> &gpio4, 3(B=1, 所以 B3 = 8+3 = 11)
         *   详细换算见文件末尾"GPIO 编号换算" */
        dc-gpios = <&gpio3 5 GPIO_ACTIVE_HIGH>;      /* !!!FILL!!! */

        /* RES: 复位。接屏幕的 RES 引脚。低电平有效。 */
        reset-gpios = <&gpio3 4 GPIO_ACTIVE_LOW>;    /* !!!FILL!!! */

        /* BLK: 背光。如果没有单独接 GPIO, 而是直接接 3.3V, 就删掉这行。
         * 接 PWM 引脚的话这里也写 gpio, 亮度调节另做。 */
        /* backlight-gpios = <&gpio3 3 GPIO_ACTIVE_HIGH>; */  /* !!!FILL!!! */

        /* ---- 显示参数 ---- */

        /* 显存偏移。240x240 屏的 RAM 是 240x320, 竖向有 80 行冗余,
         * 默认从上往下对齐, 画面会偏上。
         * 1.54 寸常见偏移: (0, 0) 或 (0, 80)
         * 画面整体上移/下移的话调这个。 */
        offset-x = <0>;
        offset-y = <0>;

        /* 旋转。0/90/180/270 */
        rotation = <0>;

        /* 像素格式。RGB565 = 16bit, 带宽最省, 也是 LVGL 默认格式 */
        bits-per-pixel = <16>;

        /* IPS 屏需要反色。某些驱动私有属性, 名字可能不同:
         *   fbtft: 用 gamma / init 序列里带 INVON
         *   私有驱动: 可能叫 st7789v,inv 或类似
         * 如果显示黑白颠倒, 把这条加上(或删掉试试)。 */
        /* invert; */
    };
};

/* ============================================================
 * 三、驱动方案二选一 (重要!)
 *
 * 官方 Rockchip 内核里【没有】ST7789 的 panel 驱动。
 * 你有三个选择, 按推荐顺序:
 *
 * ------------------------------------------------------------
 * 方案 A: fbtft 驱动 (最推荐, 内核自带)
 * ------------------------------------------------------------
 *   优点: 内核源码自带, 不用写驱动代码, 只改设备树
 *   缺点: fbtft 是 staging 驱动, 需要内核编译时启用
 *
 *   步骤:
 *   1. 内核配置(menuconfig 或直接改 defconfig):
 *        CONFIG_FB_TFT=y
 *        CONFIG_FB_TFT_ST7789V=y      << 这个就是 ST7789 支持
 *        CONFIG_FB_TFT_FBTFT_DEVICE=y
 *        CONFIG_SPI=y
 *        CONFIG_FB=y
 *
 *   2. 设备树改成 fbtft 的 compatible, 属性名也换成 fbtft 的:
 *
 *      panel: st7789@0 {
 *          compatible = "sitronix,st7789v";
 *          reg = <0>;
 *          spi-max-frequency = <40000000>;
 *
 *          // fbtft 专用属性名(注意不是 dc-gpios 而是 dc-gpios 同名但
 *          // 有些老版本用 "dc-gpio" 单数形式, 看你的内核版本)
 *          dc-gpios    = <&gpio3 5 GPIO_ACTIVE_HIGH>;
 *          reset-gpios = <&gpio3 4 GPIO_ACTIVE_LOW>;
 *
 *          // fbtft 用这些属性而不是 width/height
 *          rotate = <0>;
 *          fps    = <30>;
 *          buswidth = <8>;
 *          width  = <240>;
 *          height = <240>;
 *          debug  = <0>;
 *
 *          // fbtft 需要 init 序列(如果内核自带的不匹配你的屏)
 *          // init = <...>;  // 可选, 不写则用驱动内置序列
 *      };
 *
 *   3. 重编译内核+设备树, 烧录, 启动后应该出现 /dev/fb1
 *
 * ------------------------------------------------------------
 * 方案 B: 自己写内核驱动
 * ------------------------------------------------------------
 *   参考: kernel/drivers/gpu/drm/panel/panel-sitronix-st7789v.c
 *   (注意: 这个 DRM 版驱动是给 MIPI-DSI 用的, SPI 版需要改)
 *
 *   工作量: 2~4 周。除非有特殊需求, 不推荐。
 *
 * ------------------------------------------------------------
 * 方案 C: 用户态驱动 (我已经写好了!)
 * ------------------------------------------------------------
 *   就是我写的 src/ui/st7789.c, 走 /dev/spidev3.0 + GPIO。
 *
 *   设备树只需要把 spi3 启用了, 加一个 spidev 子节点即可:
 *
 *      &spi3 {
 *          status = "okay";
 *          max-freq = <40000000>;
 *          pinctrl-names = "default";
 *          pinctrl-0 = <&spi3m0_pins &spi3m0_cs0>;
 *
 *          spidev@0 {
 *              compatible = "rohm,dh2228fv";   // Linux 通用 spidev 兼容字符串
 *              reg = <0>;
 *              spi-max-frequency = <40000000>;
 *              status = "okay";
 *          };
 *      };
 *
 *   然后 DC/RES/BLK 三个 GPIO 在用户态直接用 /dev/gpiochip 操作,
 *   完全不用在内核里注册。
 *
 *   ★ 优点: 不用重编内核(只编设备树), 改一行就能试 M0/M1,
 *           调试快 10 倍。GPIO 编号改了也不用重编。
 *   ★ 缺点: 刷新率比内核驱动略低(少了内核的优化), 但对 240x240
 *           这种小屏完全够用(实测 40MHz 下全屏约 25ms = 40fps)。
 *
 * ============================================================
 * 四、编译与部署
 * ============================================================
 *
 * 1. 把本文件内容【合并】到板级 dts 末尾(不要直接覆盖!)
 *
 *    cd <sdk>/kernel/arch/arm64/boot/dts/rockchip/
 *    cp tspi-rk3566-user-v10-linux.dts{,.bak}
 *    vim tspi-rk3566-user-v10-linux.dts
 *    # 在文件最末尾粘贴本文件的 &spi3 { ... } 部分
 *
 *    注意: &spi3 这种"引用式"修改必须放在板级 dts 里,
 *    不能放在被 include 的文件里(会报符号未定义)。
 *
 * 2. 编译
 *    如果只改设备树, 可以单独编 dtb:
 *      cd <sdk>/kernel
 *      make ARCH=arm64 tspi-rk3566-user-v10-linux.dtb
 *      # 产物在 arch/arm64/boot/dts/rockchip/*.dtb
 *
 *    替换板子上的 dtb(位置取决于你的系统):
 *      # 如果是 buildroot/debian, 通常在 /boot/
 *      scp tspi-rk3566-user-v10-linux.dtb root@<IP>:/boot/
 *      # 有些系统需要改 /boot/extlinux/extlinux.conf 或 uEnv.txt 指定
 *
 * 3. 重启并验证
 *      # 看驱动是否加载
 *      dmesg | grep -i -E "st7789|spi3|fb1|lcd"
 *
 *      # 看有没有 framebuffer
 *      ls /dev/fb*
 *      cat /proc/fb
 *
 *      # 如果有 /dev/fb1, 测试刷屏
 *      dd if=/dev/urandom of=/dev/fb1 bs=240 count=240 2>/dev/null
 *      # 屏幕应该出现噪点图案 —— 出现就说明通了!
 *
 * ============================================================
 * 五、GPIO 编号换算 (Rockchip 公式)
 * ============================================================
 *
 * 公式: 全局编号 = 组号 * 32 + 组内字母值 * 8 + 数字
 *       A=0, B=1, C=2, D=3
 *
 * 举例:
 *   GPIO4_A6 = 4*32 + 0*8 + 6 = 134
 *   GPIO4_B2 = 4*32 + 1*8 + 2 = 138
 *   GPIO4_B3 = 4*32 + 1*8 + 3 = 139
 *   GPIO3_A1 = 3*32 + 0*8 + 1 = 97
 *
 * 设备树里【不需要换算】, 直接写 <&gpio4 6 ...> 这种形式:
 *   GPIO4_A6 -> <&gpio4 6 GPIO_ACTIVE_HIGH>
 *   GPIO4_B3 -> <&gpio4 11 GPIO_ACTIVE_HIGH>   (B3: B=8, +3 = 11)
 *
 * 用户态(方案 C)才用得到全局编号, 可以用 gpioinfo 查:
 *   gpioinfo | grep -n "" | head -50    # 看每个 chip 的 line 数和名称
 *
 * ============================================================
 * 六、泰山派 40pin 排针上可用的 SPI3 引脚 (M0 组)
 * ============================================================
 *
 * 依据 Radxa CM3/RK3566 通用 40pin 定义(泰山派兼容):
 *
 *   物理引脚 19: SPI3_MOSI_M0 = GPIO4_B2   -> 接屏幕 SDA
 *   物理引脚 23: SPI3_CLK_M0  = GPIO4_B3   -> 接屏幕 SCL
 *   物理引脚 24: SPI3_CS0_M0  = GPIO4_A6   -> 接屏幕 CS
 *
 *   DC / RES / BLK 用剩下的任意空闲 GPIO, 比如:
 *   物理引脚 11: GPIO3_A1 = 97   (可作 DC)
 *   物理引脚 13: GPIO0_C4 = 20   (可作 RES)  -- 注意此脚可能有其他复用
 *   物理引脚 15: GPIO0_C6 = 22   (可作 BLK)
 *
 *   ★ 但!! 不同版本泰山派的 40pin 丝印和复用可能不同,
 *     务必以你板子的【原理图】和丝印为准, 不要照抄上面的引脚号。
 *     验证方法: 接好后用 gpioinfo 或实测电平确认。
 *
 * ============================================================
 */
